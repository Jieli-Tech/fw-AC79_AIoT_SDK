#include "os/os_api.h"
#include "spinlock.h"
#include "device/device.h"
#include "app_config.h"
#include "usb/usb_phy.h"
#include "server/audio_server.h"

/*
使用方法
1、在app_config.h使用USB从机的MASSSTORAGE_CLASS功能
2、在版籍board_xxx.c声明:extern const struct device_operations ram_disk_dev_ops;
3、在版籍board_xxx.c添加
在REGISTER_DEVICES(device_table) = {
	//数组中添加
    {"vir_udisk",  &ram_disk_dev_ops, NULL},
*/

#if TCFG_VIR_UDISK_ENABLE

//模拟2GByte U盘的配置
#define BLOCK_SIZE 512u
#define CLUSTER_SIZE 0x4000u
#define BLOCK_NUM (2 * 1024 * 1024 * 1024u / BLOCK_SIZE)

#define RESERVED_SECTOR_SIZE 0x1806u
#define TOTAL_SECTOR_SIZE 0x3fe800u
#define FAT_TABLE_SECTOR_SIZE 0x3fdu
#define BSP_VOL_ID 0x4cfc8d04u

#define FILE_START_CLUSTER 6
#if TCFG_USER_VIRTUAL_PLAY_ENABLE
#define FILE_SIZE 0x25800000ull
/* #define FILE_SIZE 0x12c00000u */
#define FILE_NUM 3
#else
#define FILE_SIZE 0
#define FILE_NUM 0
#endif

#define DATE_TIME_YEAR 		2022u
#define DATE_TIME_MONTH		2u
#define DATE_TIME_DAY		14u
#define DATE_TIME_HOUR		13u
#define DATE_TIME_MINUTE	14u
#define DATE_TIME_SEC		0u
#define DATE_TIME			(((((DATE_TIME_YEAR - 1980) << 9) | (DATE_TIME_MONTH << 5) | DATE_TIME_DAY) << 16) | (DATE_TIME_HOUR << 11) | (DATE_TIME_MINUTE << 5) | (DATE_TIME_SEC / 2))

#define TOTAL_FILE_SIZE (FILE_SIZE * FILE_NUM + FILE_START_CLUSTER * CLUSTER_SIZE)
#define FAT_TABLE1_OFFSET (RESERVED_SECTOR_SIZE * BLOCK_SIZE)
#define FAT_TABLE2_OFFSET ((RESERVED_SECTOR_SIZE + FAT_TABLE_SECTOR_SIZE) * BLOCK_SIZE)
#define ROOT_TABLE_OFFSET ((RESERVED_SECTOR_SIZE + FAT_TABLE_SECTOR_SIZE * 2) * BLOCK_SIZE)
#define FILE_START_OFFSET ((RESERVED_SECTOR_SIZE + FAT_TABLE_SECTOR_SIZE * 2) * BLOCK_SIZE + CLUSTER_SIZE * 4)

#if TCFG_USER_VIRTUAL_PLAY_ENABLE
static struct {
    const char *file_name;	//暂时只支持短文件名8+3规则
    u32 file_size;			//需要对齐到簇大小
} file_inf[FILE_NUM] = {
    {"MUSIC1.WAV", FILE_SIZE},
    {"MUSIC2.WAV", FILE_SIZE},
    {"MUSIC3.WAV", FILE_SIZE},
};
#endif

static const unsigned char WIN_FAT32_HEAD[] = {
    0xEB, 0x58, 0x90, 0x4D, 0x53, 0x44, 0x4F, 0x53, 0x35, 0x2E, 0x30, 0x00, 0x02, 0x20, LOBYTE(RESERVED_SECTOR_SIZE), HIBYTE(RESERVED_SECTOR_SIZE), //offset:14-15 保留扇区数目
    0x02, 0x00, 0x00, 0x00, 0x00, 0xF8, 0x00, 0x00, 0x3F, 0x00, 0xFF, 0x00, 0x80, 0x00, 0x00, 0x00, //offset:28-31 FAT区前隐藏扇区数
    DW1BYTE(TOTAL_SECTOR_SIZE), DW2BYTE(TOTAL_SECTOR_SIZE), DW3BYTE(TOTAL_SECTOR_SIZE), DW4BYTE(TOTAL_SECTOR_SIZE), DW1BYTE(FAT_TABLE_SECTOR_SIZE), DW2BYTE(FAT_TABLE_SECTOR_SIZE), DW3BYTE(FAT_TABLE_SECTOR_SIZE), DW4BYTE(FAT_TABLE_SECTOR_SIZE), 0x00, 0x00, 0x00, 0x00, 0x02, 0x00, 0x00, 0x00, //offset:32-35 该卷总扇区数   offset:36-39 一个FAT表扇区数
    0x01, 0x00, 0x06, 0x00, 0x00, 0x00, 0x00, 0x00, 0x00, 0x00, 0x00, 0x00, 0x00, 0x00, 0x00, 0x00,
    0x80, 0x00, 0x29, DW1BYTE(BSP_VOL_ID), DW2BYTE(BSP_VOL_ID), DW3BYTE(BSP_VOL_ID), DW4BYTE(BSP_VOL_ID), 0x4E, 0x4F, 0x20, 0x4E, 0x41, 0x4D, 0x45, 0x20, 0x20, //offset:67-70 BS volID
    0x20, 0x20, 0x46, 0x41, 0x54, 0x33, 0x32, 0x20, 0x20, 0x20, 0x33, 0xC9, 0x8E, 0xD1, 0xBC, 0xF4,
    0x7B, 0x8E, 0xC1, 0x8E, 0xD9, 0xBD, 0x00, 0x7C, 0x88, 0x56, 0x40, 0x88, 0x4E, 0x02, 0x8A, 0x56,
    0x40, 0xB4, 0x41, 0xBB, 0xAA, 0x55, 0xCD, 0x13, 0x72, 0x10, 0x81, 0xFB, 0x55, 0xAA, 0x75, 0x0A,
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    0x00, 0x00, 0x00, 0x00, 0x00, 0x00, 0x00, 0x00, 0xAC, 0x01, 0xB9, 0x01, 0x00, 0x00, 0x55, 0xAA,
};

static const unsigned char WIN_FAT32_HEAD1[] = {
    0x00, 0x00, 0x00, 0x00, 0x72, 0x72, 0x41, 0x61, 0x3A, 0x1D, 0x01, 0x00, 0x08, 0xE1, 0x00, 0x00, //offset:9-15 上一个读写簇号缓存
    0x00, 0x00, 0x00, 0x00, 0x00, 0x00, 0x00, 0x00, 0x00, 0x00, 0x00, 0x00, 0x00, 0x00, 0x55, 0xAA,
};

static const unsigned char WIN_FAT32_HEAD2[] = {
    0x00, 0x00, 0x00, 0x00, 0x72, 0x72, 0x41, 0x61, 0xFF, 0xFF, 0xFF, 0xFF, 0x02, 0x00, 0x00, 0x00,
    0x00, 0x00, 0x00, 0x00, 0x00, 0x00, 0x00, 0x00, 0x00, 0x00, 0x00, 0x00, 0x00, 0x00, 0x55, 0xAA,
};

static const unsigned char WIN_FAT32_HEAD3[] = {
    0x0D, 0x0A, 0x41, 0x6E, 0x20, 0x6F, 0x70, 0x65, 0x72, 0x61, 0x74, 0x69, 0x6E, 0x67, 0x20, 0x73,
    0x79, 0x73, 0x74, 0x65, 0x6D, 0x20, 0x77, 0x61, 0x73, 0x6E, 0x27, 0x74, 0x20, 0x66, 0x6F, 0x75,
    0x6E, 0x64, 0x2E, 0x20, 0x54, 0x72, 0x79, 0x20, 0x64, 0x69, 0x73, 0x63, 0x6F, 0x6E, 0x6E, 0x65,
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    0x00, 0x00, 0x00, 0x00, 0x00, 0x00, 0x00, 0x00, 0x00, 0x00, 0x00, 0x00, 0x00, 0x00, 0x55, 0xAA,
};

static const unsigned char WIN_FAT32_FAT_TABLE_HEAD[] = {
    0xF8, 0xFF, 0xFF, 0x0F, 0xFF, 0xFF, 0xFF, 0xFF, 0xFF, 0xFF, 0xFF, 0x0F, 0xFF, 0xFF, 0xFF, 0x0F,
    0xFF, 0xFF, 0xFF, 0x0F, 0xFF, 0xFF, 0xFF, 0x0F,
};

static const unsigned char WIN_FAT32_ROOT_TABLE_HEAD[] = {
    0x4A, 0x4c, 0x2D, 0x55, 0x44, 0x49, 0x53, 0x4B, 0x20, 0x20, 0x20, 0x08, 0x00, 0x00, 0x00, 0x00, //u盘名称
    0x00, 0x00, 0x00, 0x00, 0x00, 0x00, DW1BYTE(DATE_TIME), DW2BYTE(DATE_TIME), DW3BYTE(DATE_TIME), DW4BYTE(DATE_TIME), 0x00, 0x00, 0x00, 0x00, 0x00, 0x00,
    0x42, 0x20, 0x00, 0x49, 0x00, 0x6E, 0x00, 0x66, 0x00, 0x6F, 0x00, 0x0F, 0x00, 0x72, 0x72, 0x00,
    0x6D, 0x00, 0x61, 0x00, 0x74, 0x00, 0x69, 0x00, 0x6F, 0x00, 0x00, 0x00, 0x6E, 0x00, 0x00, 0x00,
    0x01, 0x53, 0x00, 0x79, 0x00, 0x73, 0x00, 0x74, 0x00, 0x65, 0x00, 0x0F, 0x00, 0x72, 0x6D, 0x00,
    0x20, 0x00, 0x56, 0x00, 0x6F, 0x00, 0x6C, 0x00, 0x75, 0x00, 0x00, 0x00, 0x6D, 0x00, 0x65, 0x00,
    0x53, 0x59, 0x53, 0x54, 0x45, 0x4D, 0x7E, 0x31, 0x20, 0x20, 0x20, 0x16, 0x00, 0x00, DW1BYTE(DATE_TIME), DW2BYTE(DATE_TIME),
    DW3BYTE(DATE_TIME), DW4BYTE(DATE_TIME), DW3BYTE(DATE_TIME), DW4BYTE(DATE_TIME), 0x00, 0x00, DW1BYTE(DATE_TIME), DW2BYTE(DATE_TIME), DW3BYTE(DATE_TIME), DW4BYTE(DATE_TIME), 0x03, 0x00, 0x00, 0x00, 0x00, 0x00,
};

static const unsigned char WIN_FAT32_SYSTEM_VOLUME_INF_HEAD[] = {
    0x2E, 0x20, 0x20, 0x20, 0x20, 0x20, 0x20, 0x20, 0x20, 0x20, 0x20, 0x10, 0x00, 0x00, DW1BYTE(DATE_TIME), DW2BYTE(DATE_TIME),
    DW3BYTE(DATE_TIME), DW4BYTE(DATE_TIME), DW3BYTE(DATE_TIME), DW4BYTE(DATE_TIME), 0x00, 0x00, DW1BYTE(DATE_TIME), DW2BYTE(DATE_TIME), DW3BYTE(DATE_TIME), DW4BYTE(DATE_TIME), 0x03, 0x00, 0x00, 0x00, 0x00, 0x00,
    0x2E, 0x2E, 0x20, 0x20, 0x20, 0x20, 0x20, 0x20, 0x20, 0x20, 0x20, 0x10, 0x00, 0x00, DW1BYTE(DATE_TIME), DW2BYTE(DATE_TIME),
    DW3BYTE(DATE_TIME), DW4BYTE(DATE_TIME), DW3BYTE(DATE_TIME), DW4BYTE(DATE_TIME), 0x00, 0x00, DW1BYTE(DATE_TIME), DW2BYTE(DATE_TIME), DW3BYTE(DATE_TIME), DW4BYTE(DATE_TIME), 0x00, 0x00, 0x00, 0x00, 0x00, 0x00,
    0x42, 0x74, 0x00, 0x00, 0x00, 0xFF, 0xFF, 0xFF, 0xFF, 0xFF, 0xFF, 0x0F, 0x00, 0xCE, 0xFF, 0xFF,
    0xFF, 0xFF, 0xFF, 0xFF, 0xFF, 0xFF, 0xFF, 0xFF, 0xFF, 0xFF, 0x00, 0x00, 0xFF, 0xFF, 0xFF, 0xFF,
    0x01, 0x57, 0x00, 0x50, 0x00, 0x53, 0x00, 0x65, 0x00, 0x74, 0x00, 0x0F, 0x00, 0xCE, 0x74, 0x00,
    0x69, 0x00, 0x6E, 0x00, 0x67, 0x00, 0x73, 0x00, 0x2E, 0x00, 0x00, 0x00, 0x64, 0x00, 0x61, 0x00,
    0x57, 0x50, 0x53, 0x45, 0x54, 0x54, 0x7E, 0x31, 0x44, 0x41, 0x54, 0x20, 0x00, 0x01, DW1BYTE(DATE_TIME), DW2BYTE(DATE_TIME),
    DW3BYTE(DATE_TIME), DW4BYTE(DATE_TIME), DW3BYTE(DATE_TIME), DW4BYTE(DATE_TIME), 0x00, 0x00, DW1BYTE(DATE_TIME), DW2BYTE(DATE_TIME), DW3BYTE(DATE_TIME), DW4BYTE(DATE_TIME), 0x04, 0x00, 0x0C, 0x00, 0x00, 0x00,
    0x42, 0x47, 0x00, 0x75, 0x00, 0x69, 0x00, 0x64, 0x00, 0x00, 0x00, 0x0F, 0x00, 0xFF, 0xFF, 0xFF,
    0xFF, 0xFF, 0xFF, 0xFF, 0xFF, 0xFF, 0xFF, 0xFF, 0xFF, 0xFF, 0x00, 0x00, 0xFF, 0xFF, 0xFF, 0xFF,
    0x01, 0x49, 0x00, 0x6E, 0x00, 0x64, 0x00, 0x65, 0x00, 0x78, 0x00, 0x0F, 0x00, 0xFF, 0x65, 0x00,
    0x72, 0x00, 0x56, 0x00, 0x6F, 0x00, 0x6C, 0x00, 0x75, 0x00, 0x00, 0x00, 0x6D, 0x00, 0x65, 0x00,
    0x49, 0x4E, 0x44, 0x45, 0x58, 0x45, 0x7E, 0x31, 0x20, 0x20, 0x20, 0x20, 0x00, 0x02, DW1BYTE(DATE_TIME), DW2BYTE(DATE_TIME),
    DW3BYTE(DATE_TIME), DW4BYTE(DATE_TIME), DW3BYTE(DATE_TIME), DW4BYTE(DATE_TIME), 0x00, 0x00, DW1BYTE(DATE_TIME), DW2BYTE(DATE_TIME), DW3BYTE(DATE_TIME), DW4BYTE(DATE_TIME), 0x05, 0x00, 0x4C, 0x00, 0x00, 0x00,
};

#if TCFG_USER_VIRTUAL_PLAY_ENABLE
static const unsigned char WAV_INF_HEAD[44] = {
    0x52, 0x49, 0x46, 0x46, DW1BYTE(FILE_SIZE - 8), DW2BYTE(FILE_SIZE - 8), DW3BYTE(FILE_SIZE - 8), DW4BYTE(FILE_SIZE - 8), 0x57, 0x41, 0x56, 0x45, 0x66, 0x6D, 0x74, 0x20,
    0x10, 0x00, 0x00, 0x00, 0x01, 0x00, 0x02, 0x00, 0x44, 0xAC, 0x00, 0x00, 0x10, 0xB1, 0x02, 0x00,
    0x04, 0x00, 0x10, 0x00, 0x64, 0x61, 0x74, 0x61, DW1BYTE(FILE_SIZE - 44), DW2BYTE(FILE_SIZE - 44), DW3BYTE(FILE_SIZE - 44), DW4BYTE(FILE_SIZE - 44),
};

struct user_virtual_vfs_handle {
    volatile u8 reading;
    volatile u8 wait_stop;
    spinlock_t lock;
    u8 suspend;
    OS_SEM sem;
    struct audio_cbuf_t *virtual;
};

static struct user_virtual_vfs_handle ufs;

void set_user_virtual_play_hdl(void *virtual)
{
    spin_lock(&ufs.lock);
    ufs.wait_stop = virtual ? 0 : 1;
    while (ufs.reading) {
        spin_unlock(&ufs.lock);
        if (!virtual && ufs.virtual && ufs.virtual->rd_sem) {
            os_sem_post(ufs.virtual->rd_sem);
        }
        os_time_dly(1);
        spin_lock(&ufs.lock);
    }
    ufs.virtual = virtual;
    spin_unlock(&ufs.lock);
}

int user_virtual_play_read_data(void *buf, u32 len)
{
    u32 rlen = 0;

    spin_lock(&ufs.lock);
    if (!ufs.virtual || ufs.wait_stop) {
        ufs.reading = 0;
        spin_unlock(&ufs.lock);
        memset(buf, 0, len);
        return len;
    }
    ufs.reading = 1;
    spin_unlock(&ufs.lock);

    rlen = cbuf_read(ufs.virtual->cbuf, buf, len);
    if (rlen != len && ufs.virtual->end) {
        ufs.virtual->end = 2;
    }

    os_sem_post(ufs.virtual->wr_sem);
    ufs.reading = 0;
    return len;
}
#endif

/* static u8 ram_disk_buf[RAM_DISK_SIZE] ALIGNE(4); */
static struct device ram_disk_dev;

static int ram_disk_dev_init(const struct dev_node *node, void *arg)
{
    printf("ram_disk_dev_init\n");

    return 0;
}

static int ram_disk_dev_open(const char *name, struct device **device, void *arg)
{
    *device = &ram_disk_dev;
    (*device)->private_data = NULL;
    return 0;
}

static int ram_disk_dev_close(struct device *device)
{
    return 0;
}

static int ram_disk_dev_read(struct device *device, void *buf, u32 len, u32 offset)
{
    int i = 0;
    u32 wlen = 0;
    u8 *data = (u8 *)buf;
    len *= BLOCK_SIZE;
    offset *= BLOCK_SIZE;
    u8 has_read = 0;

    while (len > wlen) {
        if (offset < FAT_TABLE1_OFFSET) {
            //引导扇区
            if (offset == 0 || offset == 0xc00) {
                memcpy(data + wlen, WIN_FAT32_HEAD, sizeof(WIN_FAT32_HEAD));
            } else if (offset == 0x200) {
                memset(data + wlen, 0x00, BLOCK_SIZE);
                memcpy(data + wlen, "RRaA", 4);
                memcpy(data + wlen + 0x1e0, WIN_FAT32_HEAD1, sizeof(WIN_FAT32_HEAD1));
            } else if (offset == 0xc00 + 0x200) {
                memset(data + wlen, 0x00, BLOCK_SIZE);
                memcpy(data + wlen, "RRaA", 4);
                memcpy(data + wlen + 0x1e0, WIN_FAT32_HEAD2, sizeof(WIN_FAT32_HEAD2));
            } else if (offset == 0x200 * 2 || offset == 0xc00 + 0x200 * 2) {
                memset(data + wlen, 0x00, BLOCK_SIZE);
                data[wlen + 0x200 - 2] = 0x55;
                data[wlen + 0x200 - 1] = 0xAA;
            } else if (offset == 0x1800) {
                memcpy(data + wlen, WIN_FAT32_HEAD3, 0x200);
            } else {
                memset(data + wlen, 0, BLOCK_SIZE);
            }
        } else if (offset >= FAT_TABLE1_OFFSET && offset < FAT_TABLE2_OFFSET) {
            //FAT表1
#if TCFG_USER_VIRTUAL_PLAY_ENABLE
            if (offset + BLOCK_SIZE < FAT_TABLE1_OFFSET + (TOTAL_FILE_SIZE * 4 / CLUSTER_SIZE)) {
                for (i = 0; i < BLOCK_SIZE / 4; ++i) {
                    *((int *)(data + wlen) + i) = (offset - FAT_TABLE1_OFFSET) / 4 + i + 1;
                }
                if (offset == FAT_TABLE1_OFFSET) {
                    memcpy(data + wlen, WIN_FAT32_FAT_TABLE_HEAD, sizeof(WIN_FAT32_FAT_TABLE_HEAD));
                }
            } else if (offset < FAT_TABLE1_OFFSET + (TOTAL_FILE_SIZE * 4 / CLUSTER_SIZE)) {
                memset(data + wlen, 0, BLOCK_SIZE);
                for (i = 0; i < (FAT_TABLE1_OFFSET + (TOTAL_FILE_SIZE * 4 / CLUSTER_SIZE) - offset) / 4; ++i) {
                    *((int *)(data + wlen) + i) = (offset - FAT_TABLE1_OFFSET) / 4 + i + 1;
                }
            } else {
                memset(data + wlen, 0, BLOCK_SIZE);
            }
            for (u32 j = 0, start_clust = FILE_START_CLUSTER; j < ARRAY_SIZE(file_inf); ++j) {
                int end_offset = FAT_TABLE1_OFFSET + (start_clust + file_inf[j].file_size / CLUSTER_SIZE) * 4;
                if (end_offset - (int)offset >= 0 && end_offset - (int)offset < BLOCK_SIZE) {
                    *((int *)(data + wlen) + (end_offset - offset) / 4 - 1) = 0xfffffff;
                }
                start_clust += file_inf[j].file_size / CLUSTER_SIZE;
            }
#else
            if (offset == FAT_TABLE1_OFFSET) {
                memcpy(data + wlen, WIN_FAT32_FAT_TABLE_HEAD, sizeof(WIN_FAT32_FAT_TABLE_HEAD));
            } else {
                memset(data + wlen, 0, BLOCK_SIZE);
            }
#endif
        } else if (offset >= FAT_TABLE2_OFFSET && offset < ROOT_TABLE_OFFSET) {
            //FAT表2
#if TCFG_USER_VIRTUAL_PLAY_ENABLE
            if (offset + BLOCK_SIZE < FAT_TABLE2_OFFSET + (TOTAL_FILE_SIZE * 4 / CLUSTER_SIZE)) {
                for (i = 0; i < BLOCK_SIZE / 4; ++i) {
                    *((int *)(data + wlen) + i) = (offset - FAT_TABLE2_OFFSET) / 4 + i + 1;
                }
                if (offset == FAT_TABLE2_OFFSET) {
                    memcpy(data + wlen, WIN_FAT32_FAT_TABLE_HEAD, sizeof(WIN_FAT32_FAT_TABLE_HEAD));
                }
            } else if (offset < FAT_TABLE2_OFFSET + (TOTAL_FILE_SIZE * 4 / CLUSTER_SIZE)) {
                memset(data + wlen, 0, BLOCK_SIZE);
                for (i = 0; i < (FAT_TABLE2_OFFSET + (TOTAL_FILE_SIZE * 4 / CLUSTER_SIZE) - offset) / 4; ++i) {
                    *((int *)(data + wlen) + i) = (offset - FAT_TABLE2_OFFSET) / 4 + i + 1;
                }
            } else {
                memset(data + wlen, 0, BLOCK_SIZE);
            }
            for (u32 j = 0, start_clust = FILE_START_CLUSTER; j < ARRAY_SIZE(file_inf); ++j) {
                int end_offset = FAT_TABLE2_OFFSET + (start_clust + file_inf[j].file_size / CLUSTER_SIZE) * 4;
                if (end_offset - (int)offset >= 0 && end_offset - (int)offset < BLOCK_SIZE) {
                    *((int *)(data + wlen) + (end_offset - offset) / 4 - 1) = 0xfffffff;
                }
                start_clust += file_inf[j].file_size / CLUSTER_SIZE;
            }
#else
            if (offset == FAT_TABLE2_OFFSET) {
                memcpy(data + wlen, WIN_FAT32_FAT_TABLE_HEAD, sizeof(WIN_FAT32_FAT_TABLE_HEAD));
            } else {
                memset(data + wlen, 0, BLOCK_SIZE);
            }
#endif
        } else if (offset == ROOT_TABLE_OFFSET) {
            //根目录
            memset(data + wlen, 0, BLOCK_SIZE);
            memcpy(data + wlen, WIN_FAT32_ROOT_TABLE_HEAD, sizeof(WIN_FAT32_ROOT_TABLE_HEAD));

#if TCFG_USER_VIRTUAL_PLAY_ENABLE
            for (u32 i = 0, start_clust = FILE_START_CLUSTER; i < ARRAY_SIZE(file_inf); ++i) {
                const char *p = strchr(file_inf[i].file_name, '.');
                if (p) {
                    memcpy(data + wlen + sizeof(WIN_FAT32_ROOT_TABLE_HEAD) + i * 0x20, file_inf[i].file_name, p - file_inf[i].file_name);
                    if (p - file_inf[i].file_name < 8) {
                        memset(data + wlen + sizeof(WIN_FAT32_ROOT_TABLE_HEAD) + i * 0x20 + (p - file_inf[i].file_name), 0x20, 8 - (p - file_inf[i].file_name));
                    }
                    memcpy(data + wlen + sizeof(WIN_FAT32_ROOT_TABLE_HEAD) + i * 0x20 + 8, p + 1, strlen(p + 1));
                }
                data[wlen + sizeof(WIN_FAT32_ROOT_TABLE_HEAD) + i * 0x20 + 11] = 0x20;
                data[wlen + sizeof(WIN_FAT32_ROOT_TABLE_HEAD) + i * 0x20 + 12] = 0x18;
                data[wlen + sizeof(WIN_FAT32_ROOT_TABLE_HEAD) + i * 0x20 + 13] = i;
                data[wlen + sizeof(WIN_FAT32_ROOT_TABLE_HEAD) + i * 0x20 + 14] = DW1BYTE(DATE_TIME);
                data[wlen + sizeof(WIN_FAT32_ROOT_TABLE_HEAD) + i * 0x20 + 15] = DW2BYTE(DATE_TIME);
                data[wlen + sizeof(WIN_FAT32_ROOT_TABLE_HEAD) + i * 0x20 + 16] = DW3BYTE(DATE_TIME);
                data[wlen + sizeof(WIN_FAT32_ROOT_TABLE_HEAD) + i * 0x20 + 17] = DW4BYTE(DATE_TIME);
                data[wlen + sizeof(WIN_FAT32_ROOT_TABLE_HEAD) + i * 0x20 + 18] = DW3BYTE(DATE_TIME);
                data[wlen + sizeof(WIN_FAT32_ROOT_TABLE_HEAD) + i * 0x20 + 19] = DW4BYTE(DATE_TIME);
                data[wlen + sizeof(WIN_FAT32_ROOT_TABLE_HEAD) + i * 0x20 + 20] = DW3BYTE(start_clust);
                data[wlen + sizeof(WIN_FAT32_ROOT_TABLE_HEAD) + i * 0x20 + 21] = DW4BYTE(start_clust);
                data[wlen + sizeof(WIN_FAT32_ROOT_TABLE_HEAD) + i * 0x20 + 22] = DW1BYTE(DATE_TIME);
                data[wlen + sizeof(WIN_FAT32_ROOT_TABLE_HEAD) + i * 0x20 + 23] = DW2BYTE(DATE_TIME);
                data[wlen + sizeof(WIN_FAT32_ROOT_TABLE_HEAD) + i * 0x20 + 24] = DW3BYTE(DATE_TIME);
                data[wlen + sizeof(WIN_FAT32_ROOT_TABLE_HEAD) + i * 0x20 + 25] = DW4BYTE(DATE_TIME);
                data[wlen + sizeof(WIN_FAT32_ROOT_TABLE_HEAD) + i * 0x20 + 26] = DW1BYTE(start_clust);
                data[wlen + sizeof(WIN_FAT32_ROOT_TABLE_HEAD) + i * 0x20 + 27] = DW2BYTE(start_clust);
                memcpy(data + wlen + sizeof(WIN_FAT32_ROOT_TABLE_HEAD) + i * 0x20 + 28, &file_inf[i].file_size, sizeof(file_inf[i].file_size));
                start_clust += file_inf[i].file_size / CLUSTER_SIZE;
            }
#endif
        } else if (offset == ROOT_TABLE_OFFSET + CLUSTER_SIZE) {
            //system volume information
            memset(data + wlen, 0, BLOCK_SIZE);
            memcpy(data + wlen, WIN_FAT32_SYSTEM_VOLUME_INF_HEAD, sizeof(WIN_FAT32_SYSTEM_VOLUME_INF_HEAD));
        } else if (offset == ROOT_TABLE_OFFSET + CLUSTER_SIZE * 2) {
            //WPSettings.dat
            memset(data + wlen, 0, BLOCK_SIZE);
        } else if (offset == ROOT_TABLE_OFFSET + CLUSTER_SIZE * 3) {
            //IndexerVolumeGuid
            memset(data + wlen, 0, BLOCK_SIZE);
#if TCFG_USER_VIRTUAL_PLAY_ENABLE
        } else if (offset >= FILE_START_OFFSET && offset < FILE_START_OFFSET + FILE_SIZE * FILE_NUM) {
            for (u32 i = 0, start_file_offset = FILE_START_OFFSET; i < ARRAY_SIZE(file_inf); ++i) {
                //用户数据在此读取
                if (offset == start_file_offset) {
                    memcpy(data + wlen, WAV_INF_HEAD, sizeof(WAV_INF_HEAD));
                    user_virtual_play_read_data(data + wlen + sizeof(WAV_INF_HEAD), BLOCK_SIZE - sizeof(WAV_INF_HEAD));
                    has_read = 1;
                    break;
                }

                start_file_offset += file_inf[i].file_size;
            }
            if (!has_read) {
                user_virtual_play_read_data(data + wlen, BLOCK_SIZE);
            }
#endif
        } else {
            memset(data + wlen, 0, BLOCK_SIZE);
        }

        wlen += BLOCK_SIZE;
        offset += BLOCK_SIZE;
        len -= BLOCK_SIZE;
    }

    return wlen / BLOCK_SIZE;
}

static int ram_disk_dev_write(struct device *device, void *buf, u32 len, u32 offset)
{

#if TCFG_VIR_UPDATE_ENABLE
    int ram_disk_update(const u8 * buf, const u32 len, const u32 offset);
    ram_disk_update(buf, len, offset);
#endif

    return len;
}

static int ram_disk_dev_ioctl(struct device *device, u32 cmd, u32 arg)
{
    switch (cmd) {
    case IOCTL_GET_ID:
        *((int *)arg) = 0;
        break;
    case IOCTL_GET_BLOCK_NUMBER:
        *((int *)arg) = BLOCK_NUM;
        break;
    case IOCTL_GET_SECTOR_SIZE:
        *((int *)arg) = TOTAL_SECTOR_SIZE;
        break;
    case IOCTL_GET_BLOCK_SIZE:
        *((int *)arg) = BLOCK_SIZE;
        break;
    case IOCTL_GET_CAPACITY:
        *((int *)arg) = BLOCK_NUM * BLOCK_SIZE;
        break;
    case  IOCTL_GET_STATUS:
        *((int *)arg) = 1;
        break;
    default:
        break;
    }

    return 0;
}

const struct device_operations ram_disk_dev_ops = {
    .init  = ram_disk_dev_init,
    .open  = ram_disk_dev_open,
    .read  = ram_disk_dev_read,
    .write = ram_disk_dev_write,
    .ioctl = ram_disk_dev_ioctl,
    .close = ram_disk_dev_close,
};

#endif

