#include "asm/iic.h"
#include "asm/isc.h"
#include "asm/isp_dev.h"
#include "gc2145.h"
#include "gpio.h"
#include "generic/jiffies.h"
#include "device/iic.h"
#include "device/device.h"
#include "app_config.h"

#define GC2145_DVP_WRCMD 0x78
#define GC2145_DVP_RDCMD 0x79

//摄像头分辨率选择，GC2145_30W:640*480 , GC2145_100W:1280*720 , GC2145_200W:1600*1200
#if (CONFIG_VIDEO_IMAGE_W > 1600)
#define GC2145_DEVP_INPUT_W 1600
#define GC2145_DEVP_INPUT_H 1200
#else
#define GC2145_DEVP_INPUT_W CONFIG_VIDEO_IMAGE_W
#define GC2145_DEVP_INPUT_H CONFIG_VIDEO_IMAGE_H
#endif

/*#define FPGA_TEST*/

#define CONFIG_INPUT_FPS 	20 //该帧率针对720P，VGA为2倍，1600*1200为0.5倍

#define DELAY_TIME	10

static void *iic = NULL;
static u8 gc2145_reset_io[2] = {-1, -1};
static u8 gc2145_power_io[2] = {-1, -1};

typedef struct {
    u8 addr;
    u8 value;
} Sensor_reg_ini;

const Sensor_reg_ini GC2145_INI_REG[] = {
    {0xfe, 0xf0},
    {0xfe, 0xf0},
    {0xfe, 0xf0},
    {0xfc, 0x06},
    {0xf6, 0x00},
    {0xf7, 0x1d},
#ifdef FPGA_TEST
    {0xf8, 0x80}, //pclk=mclk * (v[0:3] + 1)  //24M
#else
    {0xf8, 0x83}, //pclk=mclk * (v[0:3] + 1)   //96M
#endif
    {0xfa, 0x00},
    {0xf9, 0xfe},
    {0xf2, 0x00},
    /////////////////////////////////////////////////
    //////////////////ISP reg//////////////////////
    ////////////////////////////////////////////////////
    {0xfe, 0x00},
    {0x03, 0x04},
    {0x04, 0xe2},
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    {0x22, 0xa0},
    /*{0x24 , 0x16},*/
    {0x24, 0xab}, //强驱
    {0x25, 0x01},
    {0x26, 0x10},
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    {0x34, 0x01},
    /////////////////////////////////////////////////
    //////////////////ISP reg////////////////////
    /////////////////////////////////////////////////
    {0xfe, 0x00},
    {0x80, 0x7f},
    {0x81, 0x26},
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    {0x98, 0x40},
    /////////////////////////////////////////
    /////////// BLK ////////////////////////
    /////////////////////////////////////////
    {0xfe, 0x00},
    {0x40, 0x42},
    {0x41, 0x00},
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    {0xfe, 0x00},
    ////////////////////////////////////////
    /////////// AEC ////////////////////////
    ////////////////////////////////////////
    {0xfe, 0x01},
    {0x01, 0x04},
    {0x02, 0xc0},
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    {0x41, 0x0f},

    /////////////////////////////
    //////// INTPEE /////////////
    /////////////////////////////
    {0xfe, 0x02},
    {0x90, 0x6c},
    {0x91, 0x03},
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    {0xfe, 0x00},
    /////////////////////////////
    //////// DNDD///////////////
    /////////////////////////////
    {0xfe, 0x02},
    {0x80, 0xc1},
    {0x81, 0x08},
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    {0x8b, 0x10},
    /////////////////////////////////////////
    /////////// ASDE ////////////////////////
    /////////////////////////////////////////
    {0xfe, 0x01},
    {0x21, 0x04},
    {0xfe, 0x02},
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    {0xfe, 0x00},
    /////////////////////////////////////////
    /////////// GAMMA   ////////////////////////
    /////////////////////////////////////////

    ///////////////////gamma1////////////////////
    {0xfe, 0x02},
    {0x10, 0x09},
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    {0x3b, 0xff},
    ///////////////////////////////////////////////
    ///////////YCP ///////////////////////
    ///////////////////////////////////////////////
    {0xfe, 0x02},
    {0xd1, 0x32},
    {0xd2, 0x32},
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    {0xd8, 0xd8},
    ///////////////////abs/////////////////
    {0xfe, 0x01},
    {0x9f, 0x40},
    /////////////////////////////////////////////
    //////////////////////// LSC ///////////////
    //////////////////////////////////////////
    {0xfe, 0x01},
    {0xc2, 0x14},
    {0xc3, 0x0d},
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    {0xfe, 0x00},
    ///////////////////////////////////////////////
    /////////// AWB////////////////////////
    ///////////////////////////////////////////////
    {0xfe, 0x01},
    {0x4f, 0x00},
    {0x4f, 0x00},
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    {0x4e, 0x05},
    //{0x4c , 0x02},//A
    //{0x4d , 0x6a},
    //{0x4e , 0x06},
    {0x4c, 0x02},
    {0x4d, 0x8a},
    {0x4e, 0x06},
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    {0xfe, 0x00},
    //////////////////////////////////////////
    ///////////CC////////////////////////
    //////////////////////////////////////////
    {0xfe, 0x02},
    {0xc0, 0x01},
    {0xc1, 0x44},
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    {0xe5, 0xe0},
    //////////////////////////////////////////
    ///////////ABS ////////////////////
    //////////////////////////////////////////
    {0xfe, 0x01},
    {0x9f, 0x40},
    {0xfe, 0x00},
    //////////////////////////////////////
    ///////////  OUTPUT   ////////////////
    //////////////////////////////////////
    {0xfe, 0x00},
    {0xf2, 0x0f},
    ///////////////dark sun////////////////////
    {0xfe, 0x02},
    {0x40, 0xbf},
    {0x46, 0xcf},
    {0xfe, 0x00},
    {0xfe, 0x00},
    {0xfd, 0x00},
    {0xfa, 0x00},
    //////////////////////////////////////
    /////////  crop window   /////////////
    //////////////////////////////////////
    {0xfe, 0x00},
    {0x90, 0x01},
    {0x91, 0x00},
    {0x92, 0x00},
    {0x93, 0x00},
    {0x94, 0x00},
#if (CONFIG_VIDEO_IMAGE_W > 1280)
    //最大输出1600*1200
    {0x95, 0x04},
    {0x96, 0xb0},
    {0x97, 0x06},
    {0x98, 0x40},
#else
    //100W以下,最大输出1280*720
    {0x95, 0x02},
    {0x96, 0xd0},
    {0x97, 0x05},
    {0x98, 0x00},
    {0x99, 0x11},
    {0x9a, 0x06},
#endif
    //// AWB
    {0xfe, 0x00},
    {0xec, 0x06},
    {0xed, 0x04},
    {0xee, 0x60},
    {0xef, 0x90},
    {0xfe, 0x01},
    {0x74, 0x01},
    //// AEC
    {0xfe, 0x01},
    {0x01, 0x04},
    {0x02, 0xc0},
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    {0xfe, 0x00},
    //////////////frame rate 50Hz/////////
    {0xfe, 0x00},
#if (CONFIG_INPUT_FPS == 10)
    {0x05, 0x03},//PCLK:96M , 10FPS
    {0x06, 0xff},
    {0x07, 0x01},
    {0x08, 0xff},
#elif (CONFIG_INPUT_FPS == 15)
    {0x05, 0x02},//PCLK:96M , 15FPS
    {0x06, 0xc0},
    {0x07, 0x01},
    {0x08, 0x80},
#elif (CONFIG_INPUT_FPS == 20)
    {0x05, 0x01},//PCLK:96M , 20FPS
    {0x06, 0xc0},
    {0x07, 0x01},
    {0x08, 0x20},
#elif (CONFIG_INPUT_FPS == 25)
    {0x05, 0x01},//PCLK:96M , 25FPS
    {0x06, 0x40},
    {0x07, 0x00},
    {0x08, 0xc0},
#elif (CONFIG_INPUT_FPS == 30)
    {0x05, 0x01},//PCLK:96M , 30FPS
    {0x06, 0x20},
    {0x07, 0x00},
    {0x08, 0x40},
#else
    {0x05, 0x02},//PCLK:96M , 15FPS
    {0x06, 0xc0},
    {0x07, 0x01},
    {0x08, 0x80},
#endif
    {0xfe, 0x01},
    {0x25, 0x00},
    {0x26, 0xee},
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    {0xfe, 0x00},
};

unsigned char wrGC2145Reg(unsigned char regID, unsigned char regDat)
{
    u8 ret = 1;
    dev_ioctl(iic, IIC_IOCTL_START, 0);
    if (dev_ioctl(iic, IIC_IOCTL_TX_WITH_START_BIT, GC2145_DVP_WRCMD)) {
        ret = 0;
        printf("iic write err!!! line : %d \n", __LINE__);
        goto exit;
    }
    delay(DELAY_TIME);
    if (dev_ioctl(iic, IIC_IOCTL_TX, regID)) {
        ret = 0;
        printf("iic write err!!! line : %d \n", __LINE__);
        goto exit;
    }
    delay(DELAY_TIME);
    if (dev_ioctl(iic, IIC_IOCTL_TX_WITH_STOP_BIT, regDat)) {
        ret = 0;
        printf("iic write err!!! line : %d \n", __LINE__);
        goto exit;
    }
    delay(DELAY_TIME);

exit:
    dev_ioctl(iic, IIC_IOCTL_STOP, 0);
    return ret;
}

unsigned char rdGC2145Reg(unsigned char regID, unsigned char *regDat)
{
    u8 ret = 1;
    dev_ioctl(iic, IIC_IOCTL_START, 0);
    if (dev_ioctl(iic, IIC_IOCTL_TX_WITH_START_BIT, GC2145_DVP_WRCMD)) {
        ret = 0;
        printf("iic write err!!! line : %d \n", __LINE__);
        goto exit;
    }
    delay(DELAY_TIME);
    if (dev_ioctl(iic, IIC_IOCTL_TX_WITH_STOP_BIT, regID)) {
        ret = 0;
        printf("iic write err!!! line : %d \n", __LINE__);
        goto exit;
    }
    delay(DELAY_TIME);
    if (dev_ioctl(iic, IIC_IOCTL_TX_WITH_START_BIT, GC2145_DVP_RDCMD)) {
        ret = 0;
        printf("iic write err!!! line : %d \n", __LINE__);
        goto exit;
    }
    delay(DELAY_TIME);
    dev_ioctl(iic, IIC_IOCTL_RX_WITH_STOP_BIT, (u32)regDat);

exit:
    dev_ioctl(iic, IIC_IOCTL_STOP, 0);
    return ret;

}

void GC2145_config_SENSOR(u16 *width, u16 *height, u8 *format, u8 *frame_freq)
{
    int i;
    for (i = 0; i < sizeof(GC2145_INI_REG) / sizeof(Sensor_reg_ini); i++) {
        wrGC2145Reg(GC2145_INI_REG[i].addr, GC2145_INI_REG[i].value);
    }
    *format  = SEN_IN_FORMAT_YUYV;
    puts("\nGC2145 YUYV\n");
}
s32 GC2145_set_output_size(u16 *width, u16 *height, u8 *freq)
{
    u16 w = *width + 32;//宽多加32像素点
    u16 h = *height + 8;//高多加8像素点
    wrGC2145Reg(0xfe, 0x00);
    wrGC2145Reg(0x0f, (w >> 8) & 0xff);
    wrGC2145Reg(0x10, w & 0xff);
    wrGC2145Reg(0x0d, (h >> 8) & 0xff);
    wrGC2145Reg(0x0e, h & 0xff);
    return 0;
}

s32 GC2145_ID_check(void)
{
    u8 pid = 0x00;
    u8 ver = 0x00;
    u8 i ;

    for (i = 0; i < 3; i++) { //
        rdGC2145Reg(0xf0, &pid);
        rdGC2145Reg(0xf1, &ver);
    }

    puts("Sensor PID \n");
    puts("\n");

    if (pid != 0x21 || ver != 0x45) {
        puts("\n----not GC2145_DVP-----\n");
        return -1;
    }
    puts("\n----hello GC2145_DVP-----\n");
    return 0;

}
static s32 GC2145_powerio_ctl(u8 _power_gpio, u8 on_off)
{
    gpio_direction_output(_power_gpio, on_off);
    return 0;
}
void GC2145_reset(u8 isp_dev)
{
    u8 res_io;
    u8 powd_io;
    u8 id = 0;
    puts("GC2145 reset\n");

    if (isp_dev == ISP_DEV_0) {
        res_io = gc2145_reset_io[0];
        powd_io = gc2145_power_io[0];
    } else {
        res_io = gc2145_reset_io[1];
        powd_io = gc2145_power_io[1];
    }

    if (powd_io != (u8) - 1) {
        GC2145_powerio_ctl(powd_io, 0);
    }
    if (res_io != (u8) - 1) {
        gpio_direction_output(res_io, 1);
        gpio_direction_output(res_io, 0);
        os_time_dly(1);
        gpio_direction_output(res_io, 1);
    }

}

s32 GC2145_check(u8 isp_dev, u32 _reset_gpio, u32 _power_gpio)
{
    if (!iic) {
        if (isp_dev == ISP_DEV_0) {
            iic = dev_open("iic0", 0);
        } else {
            iic = dev_open("iic1", 0);
        }
        gc2145_reset_io[isp_dev] = (u8)_reset_gpio;
        gc2145_power_io[isp_dev] = (u8)_power_gpio;
    }
    if (iic == NULL) {
        printf("GC2145 iic open err!!!\n\n");
        return -1;
    }
    GC2145_reset(isp_dev);
    if (0 != GC2145_ID_check()) {
        dev_close(iic);
        iic = NULL;
        return -1;
    }

    return 0;
}

u16 GC2145_dvp_rd_reg(u16 addr)
{
    u8 val;
    rdGC2145Reg((u8)addr, &val);
    return val;
}

void GC2145_dvp_wr_reg(u16 addr, u16 val)
{
    wrGC2145Reg((u8)addr, (u8)val);
}

void set_rev_sensor_GC2145(u16 rev_flag)
{
    if (!rev_flag) {
        wrGC2145Reg(0x17, 0x12);
    } else {
        wrGC2145Reg(0x17, 0x11);
    }
}
static s32 GC2145_init(u8 isp_dev, u16 *width, u16 *height, u8 *format, u8 *frame_freq)
{
    puts("\n\n GC2145_init \n\n");

    if (0 != GC2145_check(isp_dev, 0, 0)) {
        return -1;
    }

    GC2145_config_SENSOR(width, height, format, frame_freq);

    return 0;
}

// *INDENT-OFF*
REGISTER_CAMERA(GC2145) = {
    .logo 				= 	"GC2145",
    .isp_dev 			= 	ISP_DEV_NONE,
    .in_format 			= 	SEN_IN_FORMAT_YUYV,
    .mbus_type          =   SEN_MBUS_PARALLEL,
    .mbus_config        =   SEN_MBUS_DATA_WIDTH_8B | SEN_MBUS_HSYNC_ACTIVE_HIGH | \
    						SEN_MBUS_PCLK_SAMPLE_FALLING | SEN_MBUS_VSYNC_ACTIVE_HIGH,
#if CONFIG_CAMERA_H_V_EXCHANGE
    .sync_config		=   SEN_MBUS_SYNC0_VSYNC_SYNC1_HSYNC,//WL82/AC791才可以H-V SYNC互换，请留意
#endif
    .fps         		= 	CONFIG_INPUT_FPS,
    .sen_size 			= 	{GC2145_DEVP_INPUT_W, GC2145_DEVP_INPUT_H},
    .cap_fps         	= 	CONFIG_INPUT_FPS,
    .sen_cap_size 		= 	{GC2145_DEVP_INPUT_W, GC2145_DEVP_INPUT_H},

    .ops                =   {
        .avin_fps           =   NULL,
        .avin_valid_signal  =   NULL,
        .avin_mode_det      =   NULL,
        .sensor_check 		= 	GC2145_check,
        .init 		        = 	GC2145_init,
        .set_size_fps 		=	GC2145_set_output_size,
        .power_ctrl         =   GC2145_powerio_ctl,
        .sleep 		        =	NULL,
        .wakeup 		    =	NULL,
        .write_reg 		    =	GC2145_dvp_wr_reg,
        .read_reg 		    =	GC2145_dvp_rd_reg,
        .set_sensor_reverse =   set_rev_sensor_GC2145,
    }
};

